## west.yml
```yaml
# Copyright (c) 2021 Nordic Semiconductor ASA
# SPDX-License-Identifier: Apache-2.0

manifest:
  self:
    west-commands: scripts/west-commands.yml

  remotes:
    - name: ncs
      url-base: https://github.com/nrfconnect
    - name: lora-net
      url-base: https://github.com/Lora-net

  projects:
    - name: nrf
      remote: ncs
      repo-path: sdk-nrf
      revision: v2.7.0
      import: true
    - name: sidewalk
      remote: ncs
      repo-path: sdk-sidewalk
      revision: v2.7.0
    - name: lbm431
      remote: lora-net
      repo-path: SWSD006
      revision: lbm_v431
    - name: lbm450
      remote: lora-net
      repo-path: SWSD006
      revision: lbm_v450
```
